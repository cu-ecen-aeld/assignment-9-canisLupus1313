## base_external/package/aesd-char/Config.in
```kconfig
config BR2_PACKAGE_AESD_CHAR
	bool "char driver assignment"
	help
	  Includes aesd char kernel modules.
```

## base_external/package/ldd/Config.in
```kconfig
config BR2_PACKAGE_LDD
	bool "ldd assignment"
	help
	  Includes ldd kernel modules.
```
